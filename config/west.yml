## config/west.yml
```yaml
manifest:
  remotes:
    - name: urob
      url-base: https://github.com/urob
  projects:
    - name: zmk
      remote: urob
      revision: main
      import: app/west.yml
  self:
    path: config
    
manifest:
  remotes:
    - name: kot149
      url-base: https://github.com/kot149
  projects:
    - name: zmk-battery-center
      remote: kot149
      revision: main
      path: app/modules/battery_center
```
